// AUTO-GENERATED by scripts/build_scripts_index.py — do not edit.
// Lists every script the firmware knows about, in this order:
//
//   [  legacy] Board-resident material farming routine. Keeping the full sequence in this  (MaterialFarmMacro)
//   [  legacy] Board-resident routine lifted verbatim from EndingCrystal's  (ApricotDenMacro)
//   [  legacy] Board-resident routine. Step 13 (was {14250, ZR}) is replaced by an  (ApricotDenInkbackMacro)
//   [compiled] 杏棱力量背包刷配件  (Script_Script_088c58)
//   [compiled] 涂击队62级跑图  (Script_Script_08ccad)
//   [compiled] 天埠罗自定义脚本  (Script_Script_4988ed)
//   [compiled] 涂击队62级跑图  (Script_Script_6366b7)
//   [compiled] 涂击队62级跑图  (Script_Script_6f505d)
//   [compiled] 20秒上塔_A位置可刷零件  (Script_Script_dcae4b)
//   [compiled] 涂击队62级跑图  (Script_Script_ff3859)
//
// Three categories feed the registry:
//   - The three hand-coded MaterialFarm / ApricotDen / ApricotDenInkback
//     macros (kept verbatim from their original headers — they were tuned
//     by hand and ship with the project).
//   - Auto-generated Script_<hash>.h files written by compile_macro.py from
//     the user's 文字版代码 .txt collection. Adding a new script is just
//     `cp new.txt scripts/macros/ && scripts/compile_macro.py` followed by
//     `pio run`; the line below expands automatically.
//   - The display `key` field is the source filename sans extension, so the
//     web UI / firmware can refer to a script by name even after re-runs.

#include "MaterialFarmMacro.h"
#include "ApricotDenMacro.h"
#include "ApricotDenInkbackMacro.h"
#include "Script_Script_088c58.h"
#include "Script_Script_08ccad.h"
#include "Script_Script_4988ed.h"
#include "Script_Script_6366b7.h"
#include "Script_Script_6f505d.h"
#include "Script_Script_dcae4b.h"
#include "Script_Script_ff3859.h"

namespace farmers {
struct CompiledScript {
  const char* key;
  const char* label;
  const char* description;
  const farmers::MacroStep* steps;
  size_t step_count;
  uint32_t cycle_ms;
};

inline constexpr CompiledScript kCompiledScripts[] = {    {"MaterialFarmMacro", "Board-resident material farming routine. Keeping the full sequence in this", "Board-resident material farming routine. Keeping the full sequence in this", kMaterialFarmMacro, kMaterialFarmStepCount, kMaterialFarmCycleMs},
    {"ApricotDenMacro", "Board-resident routine lifted verbatim from EndingCrystal's", "Board-resident routine lifted verbatim from EndingCrystal's", kApricotDenMacro, kApricotDenStepCount, kApricotDenCycleMs},
    {"ApricotDenInkbackMacro", "Board-resident routine. Step 13 (was {14250, ZR}) is replaced by an", "Board-resident routine. Step 13 (was {14250, ZR}) is replaced by an", kApricotDenInkbackMacro, kApricotDenInkbackStepCount, kApricotDenInkbackCycleMs},
    {"Script_Script_088c58", "杏棱力量背包刷配件", "杏棱力量背包刷配件", kScript_088c58Macro, kScript_088c58StepCount, kScript_088c58DurationMs},
    {"Script_Script_08ccad", "涂击队62级跑图", "涂击队62级跑图", kScript_08ccadMacro, kScript_08ccadStepCount, kScript_08ccadDurationMs},
    {"Script_Script_4988ed", "天埠罗自定义脚本", "天埠罗自定义脚本", kScript_4988edMacro, kScript_4988edStepCount, kScript_4988edDurationMs},
    {"Script_Script_6366b7", "涂击队62级跑图", "涂击队62级跑图", kScript_6366b7Macro, kScript_6366b7StepCount, kScript_6366b7DurationMs},
    {"Script_Script_6f505d", "涂击队62级跑图", "涂击队62级跑图", kScript_6f505dMacro, kScript_6f505dStepCount, kScript_6f505dDurationMs},
    {"Script_Script_dcae4b", "20秒上塔_A位置可刷零件", "20秒上塔_A位置可刷零件", kScript_dcae4bMacro, kScript_dcae4bStepCount, kScript_dcae4bDurationMs},
    {"Script_Script_ff3859", "涂击队62级跑图", "涂击队62级跑图", kScript_ff3859Macro, kScript_ff3859StepCount, kScript_ff3859DurationMs}};

inline constexpr size_t kCompiledScriptCount =
    sizeof(kCompiledScripts) / sizeof(kCompiledScripts[0]);

}  // namespace farmers
